## naclports/ports/busybox/defconfig
```kconfig
CONFIG_ACPID=n
CONFIG_ARP=n
CONFIG_ARPING=n
CONFIG_BLOCKDEV=n
CONFIG_BRCTL=n
CONFIG_EJECT=n
CONFIG_ETHER_WAKE=n
CONFIG_FBSPLASH=n
CONFIG_FDFLUSH=n
CONFIG_FDISK=n
CONFIG_FEATURE_IFUPDOWN_IP_BUILTIN=n
CONFIG_FEATURE_INETD_RPC=n
CONFIG_FEATURE_IP_LINK=n
CONFIG_FEATURE_MOUNT_LOOP=n
CONFIG_FEATURE_SUID=n
CONFIG_FREE=n
CONFIG_FREERAMDISK=n
CONFIG_FSTRIM=n
CONFIG_HDPARM=n
CONFIG_IFCONFIG=n
CONFIG_IFENSLAVE=n
CONFIG_IFPLUGD=n
CONFIG_IP=n
CONFIG_LOSETUP=n
CONFIG_MKFS_EXT2=n
CONFIG_MKFS_VFAT=n
CONFIG_MOUNT=n
CONFIG_NANDDUMP=n
CONFIG_NANDWRITE=n
CONFIG_NBDCLIENT=n
CONFIG_RAIDAUTORUN=n
CONFIG_ROUTE=n
CONFIG_SLATTACH=n
CONFIG_TUNCTL=n
CONFIG_UBIATTACH=n
CONFIG_UBIDETACH=n
CONFIG_UBIMKVOL=n
CONFIG_UBIRMVOL=n
CONFIG_UBIRSVOL=n
CONFIG_UBIUPDATEVOL=n
CONFIG_UDHCPC=n
CONFIG_UDHCPD=n
CONFIG_UMOUNT=n
CONFIG_UPTIME=n
CONFIG_WATCHDOG=n
```
